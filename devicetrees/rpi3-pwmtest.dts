/*
 * QEMU variant of rpi3.dts that DOES define the pwm node (RPI3_HAVE_PWM),
 * for exercising the PWM audio path on QEMU, which maps no PWM block.
 * Boot with QEMU_DTB=devicetrees/rpi3-pwmtest.dtb and the boot-arg pwm-sim=1
 * (registers then live in RAM and the audio engine is timer-driven). The node
 * is marked sim-only, so without pwm-sim=1 the driver declines instead of
 * touching an unmapped range (an external abort). Real hardware uses rpi3-realhw.dts.
 */
#define RPI3_HAVE_PWM 1
#define RPI3_PWM_SIM_ONLY 1

#include "rpi3.dts"
