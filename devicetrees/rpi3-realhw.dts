/*
 * Real-hardware variant of rpi3.dts, for booting via the real
 * FlorentRevest/u-boot `bootxnu` command on an actual Pi 3 rather than
 * QEMU.
 *
 * This file used to be a full hand-maintained copy of rpi3.dts that
 * differed only in `dram-size`. That arrangement drifted and went stale
 * twice: once before 2026-08-13 (docs/backlog.md item 1 - it was missing
 * every driver-wiring fix rpi3.dts had accumulated, including the
 * interrupt-cell root-cause fix), and again afterwards, silently losing
 * the `model = "BCM2837"` property whose absence makes uname(2)'s
 * HW_MACHINE sysctl return a hard EINVAL (see rpi3.dts's own comment on
 * that property). Both were found by diffing, not by a failing test -
 * this variant only gets exercised on real hardware, so drift here is
 * invisible until it matters most.
 *
 * So it is no longer a copy. devicetrees/Makefile already runs the C
 * preprocessor over these files before dtc, so the whole tree is included
 * from the single source of truth and only the one genuinely differing
 * property is overridden. Adding a node to rpi3.dts now cannot fail to
 * reach real hardware.
 */

/*
 * DRAM size reported to arm_init() via chosen/dram-size. Deliberately
 * NOT the same as rpi3.dts's QEMU value: that one is derived from
 * runvm.sh's `-m 1024` minus the VideoCore carve-out, which has no
 * bearing on a physical board. Kept at the conservative bring-up value
 * this variant has always carried.
 */
#define RPI3_DRAM_SIZE 0x08000000

/* The Pi 3 has a V3D (DARW-295); QEMU raspi3 does not. */
#define RPI3_HAVE_V3D 1
/*
 * The Pi 3's ARM generic timer counts at the 19.2 MHz crystal (the firmware
 * sets CNTFRQ_EL0 and the local timer prescaler for it). Without this XNU
 * assumed 24 MHz, so time on a real Pi ran at 19.2/24 = 0.80 of real time:
 * measured 2026-10-17 as a 30 s sleep taking 37.6 s, audio playing about four
 * semitones flat, and every Pi-timed benchmark reading 1.25x high. QEMU's
 * generic timer runs at 62.5 MHz (GTIMER_SCALE), a separate question, so
 * rpi3.dts leaves the default there.
 */
#define RPI3_TIMEBASE_HZ 19200000
#define RPI3_HAVE_PWM 1

#include "rpi3.dts"
