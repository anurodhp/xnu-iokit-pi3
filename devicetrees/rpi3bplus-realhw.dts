/*
 * Real-hardware tree for the Raspberry Pi 3 Model B+ (BCM2837B0).
 *
 * Not a copy of anything: it #includes rpi3-realhw.dts (which #includes
 * rpi3.dts), so every node and every real-hardware setting is shared
 * with the 3B and only what differs is set here. On the SoC side the
 * B+ is the 3B: same BCM2837 peripheral map, interrupt numbers, 1 GB
 * DRAM, 19.2 MHz timer, mini-UART and VideoCore (the B0 stepping adds a
 * heat spreader and higher clocks, not new registers; Linux's
 * bcm2837-rpi-3-b-plus.dts includes the same bcm2837.dtsi).
 *
 * What does differ is off-SoC:
 *   - WiFi/BT: CYW43455 (dual-band 802.11ac, BT 4.2) instead of the
 *     CYW43438, on the same SDIO (GPIO34-39 -> "sdhci") and UART0
 *     (GPIO32/33 -> "bt-uart") wiring, so the tree is unchanged there.
 *     BCM43430Wifi reads the chip id at probe and takes the CR4/43455
 *     path itself; /usr/sbin/wifi picks brcmfmac43455-sdio.* by it.
 *   - Ethernet: a Microchip LAN7515 (USB hub + LAN7800 gigabit) on the
 *     DWC2 root port instead of the SMSC LAN9514. It is a USB device, so
 *     nothing here describes it; the hub half enumerates through the
 *     same USB stack, the LAN7800 half needs its own driver
 *     (SMSC9514Ethernet does not match it).
 *
 * Build: make -C devicetrees rpi3bplus-realhw.dtb, or
 * BOARD=rpi3bplus tools/make_realhw_sd_image.sh, which builds it.
 */
#define RPI3_COMPATIBLE "raspberrypi,3-model-b-plus", "brcm,bcm2837"

#include "rpi3-realhw.dts"
